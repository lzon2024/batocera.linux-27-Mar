## package/batocera/emulators/wine-x86/Config.in
```kconfig
config BR2_PACKAGE_WINE_X86
    bool "wine-x86"
    help
      Wine & associated lib32 libraries precompiled for i386 or x86

      https://github.com/lzon2024/-wine-x86-
```
